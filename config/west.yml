## config/west.yml
```yaml
manifest:
  remotes:
    - name: zmkfirmware
      url-base: https://github.com/zmkfirmware
    - name: DoctorWangWang
      url-base: https://github.com/DoctorWangWang
  projects:
    - name: zmk
      remote: DoctorWangWang
      revision: main
      import: app/west.yml
    - name: zmk-pmw3610-driver
      remote: DoctorWangWang
      revision: main
  self:
    path: config
```
